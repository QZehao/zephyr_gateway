## boards/espressif/esp32c6_devkitm/Kconfig
```kconfig
# SPDX-License-Identifier: Apache-2.0

config HEAP_MEM_POOL_ADD_SIZE_BOARD
	int
	default 4096 if BOARD_ESP32C6_DEVKITM_ESP32C6_HPCORE
```

## boards/espressif/esp32c6_devkitm/Kconfig.esp32c6_devkitm
```kconfig
# ESP32-C6-DevKitM-1 board configuration
#
# SPDX-License-Identifier: Apache-2.0

config BOARD_ESP32C6_DEVKITM
	select SOC_ESP32_C6_WROOM_1U_N4
	select SOC_ESP32C6_HPCORE if BOARD_ESP32C6_DEVKITM_ESP32C6_HPCORE
```

## boards/espressif/esp32c6_devkitm/board.yml
```yaml
board:
  name: esp32c6_devkitm
  full_name: ESP32-C6-DevKitM-1
  vendor: espressif
  socs:
    - name: esp32c6
```

## modules/zephyr_gateway/Kconfig
```kconfig
# 树外模块 Kconfig（由 Zephyr 在 ZEPHYR_EXTRA_MODULES 中自动加载）

menu "Zephyr gateway (product)"

config ZEPHYR_GATEWAY_BUSINESS
	bool "Enable gateway business sources under repo src/"
	default y
	help
	  Compiles ../src/gateway into the application. Disable to drop product code.

config GATEWAY_CAN_ENABLE
	bool "Enable CAN bus data acquisition module"
	depends on ZEPHYR_GATEWAY_BUSINESS
	depends on CAN
	default y
	help
	  Enable CAN bus protocol module for industrial sensor data acquisition.

config GATEWAY_CAN_DEVICE
	string "CAN device name"
	depends on GATEWAY_CAN_ENABLE
	default "can0"

config GATEWAY_CAN_FILTER_ID
	hex "CAN filter ID"
	depends on GATEWAY_CAN_ENABLE
	default 0x100

config GATEWAY_CAN_FILTER_MASK
	hex "CAN filter mask"
	depends on GATEWAY_CAN_ENABLE
	default 0x7F0

config GATEWAY_MODBUS_ENABLE
	bool "Enable Modbus RTU master module"
	depends on ZEPHYR_GATEWAY_BUSINESS
	depends on SERIAL
	default y
	help
	  Enable Modbus RTU master module via UART/RS-485.

config GATEWAY_MODBUS_DEVICE
	string "UART device for Modbus"
	depends on GATEWAY_MODBUS_ENABLE
	default "uart1"

config GATEWAY_MODBUS_BAUDRATE
	int "Modbus baudrate"
	depends on GATEWAY_MODBUS_ENABLE
	default 9600

config GATEWAY_MODBUS_SLAVE_ID
	int "Modbus default slave ID"
	depends on GATEWAY_MODBUS_ENABLE
	default 1
	range 1 247

config GATEWAY_MODBUS_POLL_INTERVAL_MS
	int "Modbus poll interval (ms)"
	depends on GATEWAY_MODBUS_ENABLE
	default 1000
	range 100 10000

config GATEWAY_MQTT_ENABLE
	bool "Enable network manager and MQTT connection module"
	depends on ZEPHYR_GATEWAY_BUSINESS
	depends on NETWORKING
	depends on MQTT_LIB
	default y
	help
	  Enable network_manager (link state) and protocol_mqtt (MQTT client)
	  for cloud data upload.

config GATEWAY_MQTT_BROKER_ADDR
	string "MQTT broker address"
	depends on GATEWAY_MQTT_ENABLE
	default "broker.emqx.io"

config GATEWAY_MQTT_BROKER_PORT
	int "MQTT broker port"
	depends on GATEWAY_MQTT_ENABLE
	default 1883

config GATEWAY_MQTT_CLIENT_ID
	string "MQTT client ID"
	depends on GATEWAY_MQTT_ENABLE
	default "zephyr_gateway"

config GATEWAY_MQTT_TOPIC_TELEMETRY
	string "MQTT topic for telemetry"
	depends on GATEWAY_MQTT_ENABLE
	default "gateway/telemetry"

config GATEWAY_MQTT_TOPIC_ANOMALY
	string "MQTT topic for anomaly"
	depends on GATEWAY_MQTT_ENABLE
	default "gateway/anomaly"

config GATEWAY_ANOMALY_ENABLE
	bool "Enable adaptive threshold anomaly detection"
	depends on ZEPHYR_GATEWAY_BUSINESS
	default y
	help
	  Enable sliding-window statistical anomaly detection
	  (mean + standard deviation, Warning/Critical/Emergency levels).

config GATEWAY_ANOMALY_WINDOW_SIZE
	int "Anomaly detection sliding window size"
	depends on GATEWAY_ANOMALY_ENABLE
	default 100
	range 10 1000

config GATEWAY_ANOMALY_WARNING_SIGMA
	int "Warning threshold (sigma * 10, fixed point)"
	depends on GATEWAY_ANOMALY_ENABLE
	default 20
	help
	  Warning triggered when deviation > N/10 sigma.
	  Default 20 means 2.0 sigma.

config GATEWAY_ANOMALY_CRITICAL_SIGMA
	int "Critical threshold (sigma * 10, fixed point)"
	depends on GATEWAY_ANOMALY_ENABLE
	default 30

config GATEWAY_ANOMALY_EMERGENCY_SIGMA
	int "Emergency threshold (sigma * 10, fixed point)"
	depends on GATEWAY_ANOMALY_ENABLE
	default 40

config GATEWAY_CLOUD_UPLOAD_ENABLE
	bool "Enable cloud data upload module"
	depends on ZEPHYR_GATEWAY_BUSINESS
	depends on GATEWAY_MQTT_ENABLE
	default y
	help
	  Subscribe to sensor/anomaly events and upload via cloud provider.
	  Requires GATEWAY_MQTT_ENABLE: without it no cloud provider can be
	  selected/compiled (see GATEWAY_CLOUD_PROVIDER choice below), which
	  would otherwise silently produce a zero-Provider configuration.

if GATEWAY_CLOUD_UPLOAD_ENABLE

# ---------- 单活互斥：所有 provider 共用单一 MQTT 连接，同一时刻仅一个上云目标 ----------
choice GATEWAY_CLOUD_PROVIDER
	prompt "云平台 Provider 选择（单活互斥）"
	default GATEWAY_CLOUD_PROVIDER_PRIVATE
	depends on GATEWAY_MQTT_ENABLE
	help
	  选择上云目标。四个 provider 互斥单选：所有 provider 共用单一 MQTT 连接，
	  同一时刻仅一个上云目标激活。如需切换云平台，修改此选项并重新编译。

config GATEWAY_CLOUD_PROVIDER_PRIVATE
	bool "私有 MQTT Broker"
	help
	  连接到自托管/私有 MQTT Broker，使用标准 MQTT 协议，无特殊认证。

config GATEWAY_CLOUD_PROVIDER_ALIYUN
	bool "阿里云 IoT 平台"
	help
	  连接阿里云物联网平台，支持一机一密 HMAC-SHA1 认证、Alink JSON 格式、物模型 Topic。

config GATEWAY_CLOUD_PROVIDER_TENCENT
	bool "腾讯云 IoT Hub"
	help
	  连接腾讯云物联网通信平台，支持密钥认证（HMAC-SHA256）、腾讯云 Topic 格式。

config GATEWAY_CLOUD_PROVIDER_AWS
	bool "AWS IoT Core"
	help
	  连接 AWS IoT Core，支持 X.509 证书认证（双向 TLS）、Device Shadow Topic。
	  需同时启用 CONFIG_GATEWAY_AWS_TLS 并在部署期注入证书（sec_tag 占位）。

endchoice # GATEWAY_CLOUD_PROVIDER

# ---------- 阿里云 IoT 配置 ----------
if GATEWAY_CLOUD_PROVIDER_ALIYUN

config GATEWAY_ALIYUN_PRODUCT_KEY
	string "阿里云 ProductKey"
	default "a1Xxxxxx"

config GATEWAY_ALIYUN_DEVICE_NAME
	string "阿里云 DeviceName"
	default "device_01"

config GATEWAY_ALIYUN_DEVICE_SECRET
	string "阿里云 DeviceSecret"
	default ""

config GATEWAY_ALIYUN_REGION
	string "阿里云 Region"
	default "cn-shanghai"

endif # GATEWAY_CLOUD_PROVIDER_ALIYUN

# ---------- 腾讯云 IoT Hub 配置 ----------
if GATEWAY_CLOUD_PROVIDER_TENCENT

config GATEWAY_TENCENT_PRODUCT_ID
	string "腾讯云 ProductID"
	default "ProductID"

config GATEWAY_TENCENT_DEVICE_NAME
	string "腾讯云 DeviceName"
	default "device_01"

config GATEWAY_TENCENT_DEVICE_SECRET
	string "腾讯云 DeviceSecret"
	default ""

endif # GATEWAY_CLOUD_PROVIDER_TENCENT

# ---------- AWS IoT Core 配置 ----------
if GATEWAY_CLOUD_PROVIDER_AWS

config GATEWAY_AWS_ENDPOINT
	string "AWS IoT Endpoint（不含 ':8883'）"
	default "xxxxxx-ats.iot.us-east-1.amazonaws.com"
	help
	  AWS IoT 数据端点，格式为 <prefix>-ats.iot.<region>.amazonaws.com，
	  不含端口号（端口由 TLS 开关决定：8883 或 1883）。

config GATEWAY_AWS_THING_NAME
	string "AWS Thing Name"
	default "my_thing"

config GATEWAY_AWS_REGION
	string "AWS Region"
	default "us-east-1"

config GATEWAY_AWS_TLS
	bool "启用 AWS IoT TLS 双向认证"
	depends on MQTT_LIB_TLS
	depends on NET_SOCKETS_SOCKOPT_TLS
	default n
	help
	  启用后通过 8883 端口以双向 TLS 连接 AWS IoT Core。
	  需在部署期通过 tls_credential_add() 注入根 CA、设备证书、私钥，
	  并将对应 sec_tag 配置到 CONFIG_GATEWAY_AWS_TLS_SEC_TAG。
	  未启用时使用明文 1883 端口（仅测试用途，AWS 生产环境必须启用）。

config GATEWAY_AWS_TLS_SEC_TAG
	int "AWS TLS 证书 sec_tag"
	depends on GATEWAY_AWS_TLS
	default 100
	help
	  证书套件的 sec_tag 值（根 CA + 设备证书 + 私钥共用同一 tag，或按平台要求拆分）。
	  证书实体须在运行时通过 tls_credential_add() 注入（部署期操作，不硬编码到固件）。

endif # GATEWAY_CLOUD_PROVIDER_AWS

endif # GATEWAY_CLOUD_UPLOAD_ENABLE

config GATEWAY_CLOUD_UPLOAD_INTERVAL_MS
	int "Normal upload interval (ms)"
	depends on GATEWAY_CLOUD_UPLOAD_ENABLE
	default 5000
	range 1000 60000

config GATEWAY_OFFLINE_CACHE_ENABLE
	bool "Enable offline cache for network interruption"
	depends on ZEPHYR_GATEWAY_BUSINESS
	depends on FLASH
	depends on NVS
	default y
	help
	  Cache data to NVS when network is down, bulk upload on recovery.

config GATEWAY_OFFLINE_CACHE_MAX_ENTRIES
	int "Maximum offline cache entries"
	depends on GATEWAY_OFFLINE_CACHE_ENABLE
	default 256
	range 16 1024

config GATEWAY_OFFLINE_CACHE_ENTRY_SIZE
	int "Size of each cache entry (bytes)"
	depends on GATEWAY_OFFLINE_CACHE_ENABLE
	default 256
	range 64 512

config GATEWAY_DATA_SIMULATOR_ENABLE
	bool "Enable data simulator for functional testing"
	depends on ZEPHYR_GATEWAY_BUSINESS
	default n
	help
	  Generate random sensor data with configurable baseline and range.
	  Used for testing data pipeline without real CAN/Modbus hardware.

config GATEWAY_WEBSHELL_ENABLE
	bool "Enable gateway shell commands"
	depends on ZEPHYR_GATEWAY_BUSINESS
	depends on SHELL
	default y
	help
	  Add gateway-specific shell commands (status, can stats, modbus read, etc.)

endmenu
```
